## drivers/firmware/efi/Kconfig
```kconfig
menu "EFI (Extensible Firmware Interface) Support"
	depends on EFI

config EFI_VARS
	tristate "EFI Variable Support via sysfs"
	depends on EFI
	default n
	help
	  If you say Y here, you are able to get EFI (Extensible Firmware
	  Interface) variable information via sysfs.  You may read,
	  write, create, and destroy EFI variables through this interface.

	  Note that using this driver in concert with efibootmgr requires
	  at least test release version 0.5.0-test3 or later, which is
	  available from Matt Domsch's website located at:
	  <http://linux.dell.com/efibootmgr/testing/efibootmgr-0.5.0-test3.tar.gz>

	  Subsequent efibootmgr releases may be found at:
	  <http://linux.dell.com/efibootmgr>

config EFI_VARS_PSTORE
	tristate "Register efivars backend for pstore"
	depends on EFI_VARS && PSTORE
	default y
	help
	  Say Y here to enable use efivars as a backend to pstore. This
	  will allow writing console messages, crash dumps, or anything
	  else supported by pstore to EFI variables.

config EFI_VARS_PSTORE_DEFAULT_DISABLE
	bool "Disable using efivars as a pstore backend by default"
	depends on EFI_VARS_PSTORE
	default n
	help
	  Saying Y here will disable the use of efivars as a storage
	  backend for pstore by default. This setting can be overridden
	  using the efivars module's pstore_disable parameter.

config EFI_CAPSULE_PSTORE
	bool "EFI capsule pstore backend"
	depends on EFI && PSTORE
	help
	  The EFI capsule mechanism can be used to store crash dumps and
	  function tracing data by passing the data to the firmware, which
	  will be preserved across a reboot.

	  It should be noted that enabling this opton will pass a capsule
	  to the firmware on every boot. Some firmware will not allow a
	  user to enter the BIOS setup when a capsule has been registered
	  on the previous boot.

	  Many EFI machines have buggy implementations of the UpdateCapsule()
	  runtime service. This option will enable code that may not function
	  correctly with your firmware.

	  If unsure, say N.

config EFI_CAPSULE_BLK_DEV
	tristate "EFI capsule block device"
	depends on EFI
	help
	  This option uses the EFI capsule mechanism to reserve regions
	  for use as block devices, which allows you to create file systems
	  on them, read/write files, etc. The major advantage is that any
	  data you create on the block device will be preserved across a
	  reboot.

	  If unsure, say N.

config EFI_CAPSULE_BLK_DEV_SIZE
	int "Default EFI capsule size (Mbytes)"
	depends on EFI_CAPSULE_BLK_DEV
	default "8"

endmenu

config UEFI_CPER
	bool
```
